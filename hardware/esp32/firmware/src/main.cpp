// Q-SHIELD ESP32 firmware, protocol v1 skeleton.
// STATUS: NOT COMPILED, NOT FLASHED, NOT TESTED. Written without a connected board.
//
// Does: Wi-Fi, HMAC-SHA256 device authentication (provisioned secret; symmetric, NOT
// post-quantum), register + heartbeat with a persisted monotonic counter, and telemetry
// ONLY once the real wiring is declared (include/board.h, see docs/hardware/wiring-plan.md):
// without a real reed switch, reporting tamper=false would be a false claim.
// Does NOT: read BME280/MPU6050 yet, handle the recovery channel, or apply remediation
// commands (docs/hardware/hardware-architecture.md lists what is left).
//
// Wire format and signing input: backend/protocol/envelope.py and docs/hardware/device-protocol.md.
// Test vectors (check these first, byte for byte): tests/vectors/envelope_v1.json and
// tests/vectors/envelope_v1_cases.json (register, heartbeat, telemetry, escaping, max counter).
#include <Arduino.h>
#include <WiFi.h>
#include <HTTPClient.h>
#include <Preferences.h>
#include "mbedtls/md.h"
#include "secrets.h"  // generated by scripts/enroll_device.py; gitignored
#if __has_include("board.h")
#include "board.h"    // pin map, written once the board is identified and wired (not in the repository yet)
#endif

static const char *FW_VERSION = "esp32-0.1-skeleton";
static const uint32_t HEARTBEAT_MS = 5000;
static const uint32_t TELEMETRY_MS = 5000;
static const uint32_t BLOCKED_RETRY_MS = 30000;   // after a 403 (quarantined): stop hammering the gateway
static const uint32_t COUNTER_PERSIST_EVERY = 50;

static Preferences prefs;
static uint64_t counter = 0;
static bool registered = false;
static uint32_t blockedUntil = 0;

static String hmacHex(const String &data) {
  uint8_t out[32];
  const mbedtls_md_info_t *info = mbedtls_md_info_from_type(MBEDTLS_MD_SHA256);
  mbedtls_md_hmac(info, DEVICE_SECRET, sizeof(DEVICE_SECRET),
                  (const unsigned char *)data.c_str(), data.length(), out);
  static const char *hex = "0123456789abcdef";
  String s;
  for (int i = 0; i < 32; i++) { s += hex[out[i] >> 4]; s += hex[out[i] & 15]; }
  return s;
}

// Decimal text of a 64-bit counter, without relying on String(uint64_t) support in the core.
static String u64(uint64_t v) {
  char buf[21];
  char *p = buf + sizeof(buf) - 1;
  *p = '\0';
  do { *--p = (char)('0' + (v % 10)); v /= 10; } while (v);
  return String(p);
}

// Reserve counters ahead of use so a crash/power loss can never reuse one.
static uint64_t nextCounter() {
  counter++;
  if (counter % COUNTER_PERSIST_EVERY == 0) prefs.putULong64("ctr", counter);
  return counter;
}

// The payload travels as a JSON string inside the envelope: escape it exactly once.
// Case "register_escaped_text" in tests/vectors/envelope_v1_cases.json shows the expected bytes.
static String jsonEscape(const String &s) {
  String o;
  for (size_t i = 0; i < s.length(); i++) {
    char c = s[i];
    if (c == '"' || c == '\\') { o += '\\'; o += c; }
    else if ((unsigned char)c < 0x20) { char b[7]; snprintf(b, sizeof(b), "\\u%04x", (unsigned char)c); o += b; }
    else o += c;
  }
  return o;
}

// Returns the HTTP status (negative: transport error).
static int send(const char *path, const char *type, const String &payload) {
  uint64_t c = nextCounter();
  String signingInput = String("QSHIELD-V1\nhmac-sha256-psk\n") + type + "\n" + DEVICE_ID + "\n" + u64(c) + "\n" + payload;
  String body = String("{\"proto\":1,\"auth\":\"hmac-sha256-psk\",\"type\":\"") + type +
                "\",\"device_id\":\"" DEVICE_ID "\",\"counter\":" + u64(c) +
                ",\"payload\":\"" + jsonEscape(payload) + "\",\"tag\":\"" + hmacHex(signingInput) + "\"}";
  HTTPClient http;
  http.begin(String("http://") + GATEWAY_HOST + ":" + GATEWAY_PORT + "/api/v1/" + path);
  http.addHeader("Content-Type", "application/json");
  int code = http.POST(body);
  http.end();
  Serial.printf("%s -> %d\n", path, code);
  if (code == 403) blockedUntil = millis() + BLOCKED_RETRY_MS;   // quarantined: the normal channel is closed
  return code;
}

#ifdef QSHIELD_TAMPER_PIN
#ifndef QSHIELD_TAMPER_OPEN_LEVEL
#define QSHIELD_TAMPER_OPEN_LEVEL HIGH   // reed switch to GND with INPUT_PULLUP: lid magnet present = LOW
#endif
static const char *CAPABILITIES = "[\"tamper\"]";
// Only fields that are really measured. An absent sensor is left out, never sent as 0.
static String telemetryPayload() {
  bool open = digitalRead(QSHIELD_TAMPER_PIN) == QSHIELD_TAMPER_OPEN_LEVEL;
  String p = String("{\"tamper\":") + (open ? "true" : "false") + ",\"fw_version\":\"" + FW_VERSION +
             "\",\"rssi_dbm\":" + String((int)WiFi.RSSI());
  // BME280 (temperature_c, humidity_pct, pressure_hpa) and MPU6050 (vibration_g) are added here once wired.
  return p + "}";
}
#else
static const char *CAPABILITIES = "[]";
#endif

void setup() {
  Serial.begin(115200);
  prefs.begin("qshield", false);
  // Skip past any counters used since the last persist.
  counter = prefs.getULong64("ctr", 0) + COUNTER_PERSIST_EVERY + 1;
  prefs.putULong64("ctr", counter);
#ifdef QSHIELD_TAMPER_PIN
  pinMode(QSHIELD_TAMPER_PIN, INPUT_PULLUP);
#endif
  WiFi.mode(WIFI_STA);
  WiFi.begin(WIFI_SSID, WIFI_PASSWORD);
}

void loop() {
  static uint32_t lastBeat = 0;
  if (WiFi.status() != WL_CONNECTED) { delay(500); return; }
  if ((int32_t)(millis() - blockedUntil) < 0) { delay(500); return; }
  if (!registered) {
    String p = String("{\"fw_version\":\"") + FW_VERSION + "\",\"hw\":\"esp32\",\"capabilities\":" + CAPABILITIES + "}";
    registered = send("register", "register", p) == 200;
    if (!registered) { delay(2000); return; }
  }
  if (millis() - lastBeat >= HEARTBEAT_MS) {
    lastBeat = millis();
    if (send("heartbeat", "heartbeat", String("{\"uptime_ms\":") + u64(millis()) + "}") != 200) registered = false;
  }
#ifdef QSHIELD_TAMPER_PIN
  static uint32_t lastTelemetry = 0;
  if (millis() - lastTelemetry >= TELEMETRY_MS) {
    lastTelemetry = millis();
    send("telemetry", "telemetry", telemetryPayload());
  }
#endif
}
